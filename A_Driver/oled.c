/*
 *  oled.c  --  SSD1306 OLED 驱动 (SPI, 128x64)
 *
 *  SPI:  SCLK=PB9, MOSI=PB8 (SPI1)
 *  GPIO: RES=PB3, DC=PB2, CS=PA27
 */
#include <ti/devices/msp/msp.h>
#include <ti/driverlib/driverlib.h>
#include <ti/driverlib/m0p/dl_core.h>
#include "oled.h"

#define OLED_SPI_INST    SPI1

#define OLED_RES_PORT    GPIOB
#define OLED_RES_PIN     DL_GPIO_PIN_3
#define OLED_DC_PORT     GPIOB
#define OLED_DC_PIN      DL_GPIO_PIN_2
#define OLED_CS_PORT     GPIOA
#define OLED_CS_PIN      DL_GPIO_PIN_27

#define OLED_CMD     0
#define OLED_DATA    1

/* 5×7 ASCII 字库 (0x20~0x7F) */
static const unsigned char Font5x7[][5] = {
    {0x00,0x00,0x00,0x00,0x00}, {0x00,0x00,0x5F,0x00,0x00},
    {0x00,0x07,0x00,0x07,0x00}, {0x14,0x7F,0x14,0x7F,0x14},
    {0x24,0x2A,0x7F,0x2A,0x12}, {0x23,0x13,0x08,0x64,0x62},
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    {0x08,0x08,0x2A,0x1C,0x08}, {0x08,0x1C,0x2A,0x08,0x08},
};

/* ---- SPI 发送一个字节 ---- */
static void OLED_SPI_Write(unsigned char data)
{
    DL_SPI_transmitDataBlocking8(OLED_SPI_INST, data);
}

/* ---- 写命令 (DC=0, CS↓→发→CS↑) ---- */
static void OLED_WriteCmd(unsigned char cmd)
{
    DL_GPIO_clearPins(OLED_DC_PORT, OLED_DC_PIN);
    DL_GPIO_clearPins(OLED_CS_PORT, OLED_CS_PIN);
    OLED_SPI_Write(cmd);
    DL_GPIO_setPins(OLED_CS_PORT, OLED_CS_PIN);
}

/* ---- 写数据块 (DC=1, CS↓→发→CS↑) ---- */
static void OLED_WriteData(const unsigned char *data, unsigned int len)
{
    DL_GPIO_setPins(OLED_DC_PORT, OLED_DC_PIN);
    DL_GPIO_clearPins(OLED_CS_PORT, OLED_CS_PIN);
    unsigned int i;
    for (i = 0; i < len; i++)
        OLED_SPI_Write(data[i]);
    DL_GPIO_setPins(OLED_CS_PORT, OLED_CS_PIN);
}

static void OLED_WriteCmd2(unsigned char cmd, unsigned char arg)
{
    OLED_WriteCmd(cmd);
    OLED_WriteCmd(arg);
}

/* ---- 帧缓冲: 8 pages × 128 cols = 1024 bytes ---- */
static unsigned char gFramebuf[8][128];

/* ---- 初始化 ---- */
void OLED_Init(void)
{
    /* RES 复位: 低→延时→高 */
    DL_GPIO_clearPins(OLED_RES_PORT, OLED_RES_PIN);
    delay_cycles(32000);
    DL_GPIO_setPins(OLED_RES_PORT, OLED_RES_PIN);
    delay_cycles(320000);
    /* SSD1306 初始化命令序列 */
    OLED_WriteCmd(0xAE);       /* 关闭显示 */
    OLED_WriteCmd2(0xD5, 0x80); /* 时钟分频 */
    OLED_WriteCmd2(0xA8, 0x3F); /* 复用比 64 */
    OLED_WriteCmd2(0xD3, 0x00); /* 显示偏移 0 */
    OLED_WriteCmd(0x40);        /* 起始行 0 */
    OLED_WriteCmd2(0x8D, 0x14); /* 使能电荷泵 */
    OLED_WriteCmd2(0x20, 0x00); /* 水平寻址 */
    OLED_WriteCmd(0xA1);        /* 段重映射 */
    OLED_WriteCmd(0xC8);        /* COM 扫描方向 */
    OLED_WriteCmd2(0xDA, 0x12); /* COM 引脚 */
    OLED_WriteCmd2(0x81, 0xCF); /* 对比度 */
    OLED_WriteCmd2(0xD9, 0xF1); /* 预充电 */
    OLED_WriteCmd2(0xDB, 0x40); /* VCOMH */
    OLED_WriteCmd(0xA4);        /* 正常模式 */
    OLED_WriteCmd(0xA6);        /* 不反色 */
    OLED_WriteCmd(0xAF);        /* 开启显示 */
}

/* ---- 清屏 ---- */
void OLED_Clear(void)
{
    unsigned char p, c;
    for (p = 0; p < 8; p++)
        for (c = 0; c < 128; c++)
            gFramebuf[p][c] = 0;
}

/* ---- 刷新 ---- */
void OLED_Refresh(void)
{
    OLED_WriteCmd(0x21); OLED_WriteCmd(0); OLED_WriteCmd(127);
    OLED_WriteCmd(0x22); OLED_WriteCmd(0); OLED_WriteCmd(7);
    unsigned char p;
    for (p = 0; p < 8; p++)
        OLED_WriteData(gFramebuf[p], 128);
}

/* ---- 写字符串到帧缓冲 (6×8 字体) ---- */
void OLED_ShowString(uint32_t page, uint32_t col, const char *str)
{
    while (*str) {
        if (col > 121) { col = 0; page++; }
        if (page > 7) break;

        unsigned char idx = (unsigned char)*str;
        idx = (idx < 0x20 || idx > 0x7F) ? 0 : idx - 0x20;

        unsigned char i;
        for (i = 0; i < 5; i++)
            gFramebuf[page][col + i] = Font5x7[idx][i];
        gFramebuf[page][col + 5] = 0;  /* 字符间距 */
        col += 6; str++;
    }
}

/* ---- 定位 (保留, 帧缓冲模式下无实际作用) ---- */
void OLED_SetCursor(uint32_t page, uint32_t col) { (void)page; (void)col; }
